## sdkconfig.defaults
```kconfig
# --- 目标芯片 ---
CONFIG_IDF_TARGET="esp32c3"
# 注:ESP32-C3 无 PSRAM,故不设 CONFIG_SPIRAM。

# --- Flash ---
# FoloToy AI Passport 当前产品/固件基线使用 8MB Flash。
CONFIG_ESPTOOLPY_FLASHSIZE_8MB=y
# 固定 8MB 镜像头，关闭 detect，便于 idf.py merge-bin。
CONFIG_ESPTOOLPY_HEADER_FLASHSIZE_UPDATE=n
# 3 MB 应用上限与固定保护分区保持一致。分区表保留
# cardid@0x356000，二创不得移动或覆盖。
CONFIG_PARTITION_TABLE_CUSTOM=y
CONFIG_PARTITION_TABLE_CUSTOM_FILENAME="partitions.csv"
CONFIG_PARTITION_TABLE_FILENAME="partitions.csv"

# --- 编译器优化(瘦身) ---
# -Os:优化代码体积;Debug(-Og)体积大 ~20%。
CONFIG_COMPILER_OPTIMIZATION_SIZE=y
# 禁用 C++ 异常与 RTTI(雷达应用纯 C,但 IDF 组件可能链接 C++ 运行时)。
CONFIG_COMPILER_CXX_EXCEPTIONS=n
CONFIG_COMPILER_CXX_RTTI=n
# 断言保留(开发期安全网),仅降级为非 fatal。
CONFIG_COMPILER_OPTIMIZATION_ASSERTIONS_ENABLE=y

# --- 日志(瘦身) ---
# 默认 WARN:INFO 级日志字符串占用大量 .rodata;按需用 esp_log_level_set() 临时调高。
CONFIG_LOG_DEFAULT_LEVEL_WARN=y
CONFIG_LOG_DEFAULT_LEVEL=2

# --- 控制台:USB-Serial-JTAG(C3 原生 USB,GPIO18/19)---
# 不用 UART0:其默认 TX=GPIO21 与本板背光引脚冲突。
CONFIG_ESP_CONSOLE_USB_SERIAL_JTAG=y
CONFIG_ESP_CONSOLE_SECONDARY_NONE=y

# --- LVGL(瘦身裁剪) ---
CONFIG_LV_COLOR_DEPTH_16=y
# 两种字体都在用:20px 供标题牌(ui_pixel_screen_create 每页标题),14px 供正文/行项。
CONFIG_LV_FONT_MONTSERRAT_14=y
CONFIG_LV_FONT_MONTSERRAT_20=y
# LVGL 内置 malloc 池大小(KB)。独立静态区,不与系统堆共享。
CONFIG_LV_MEM_SIZE_KILOBYTES=32
CONFIG_LV_BUILD_EXAMPLES=n
# 禁用 LVGL 内置 demo。
# CONFIG_LV_USE_DEMO_WIDGETS is not set
# CONFIG_LV_USE_DEMO_MUSIC is not set
# CONFIG_LV_USE_DEMO_STRESS is not set
# CONFIG_LV_USE_DEMO_BENCHMARK is not set
# 裁剪未使用的 widget(雷达 UI 只用 label/panel/基本对象)。
# CONFIG_LV_USE_ARC is not set
# CONFIG_LV_USE_ARCLABEL is not set
# CONFIG_LV_USE_CALENDAR is not set
# CONFIG_LV_USE_CALENDAR_HEADER_ARROW is not set
# CONFIG_LV_USE_CALENDAR_HEADER_DROPDOWN is not set
# CONFIG_LV_USE_CANVAS is not set
# CONFIG_LV_USE_CHART is not set
# CONFIG_LV_USE_CHECKBOX is not set
# CONFIG_LV_USE_DROPDOWN is not set
# CONFIG_LV_USE_IMAGEBUTTON is not set
# CONFIG_LV_USE_KEYBOARD is not set
# CONFIG_LV_USE_LED is not set
# CONFIG_LV_USE_LIST is not set
# CONFIG_LV_USE_MENU is not set
# CONFIG_LV_USE_MSGBOX is not set
# CONFIG_LV_USE_ROLLER is not set
# CONFIG_LV_USE_SCALE is not set
# CONFIG_LV_USE_SLIDER is not set
# CONFIG_LV_USE_SPAN is not set
# CONFIG_LV_USE_SPINBOX is not set
# CONFIG_LV_USE_SPINNER is not set
# CONFIG_LV_USE_SWITCH is not set
# CONFIG_LV_USE_TEXTAREA is not set
# CONFIG_LV_USE_TABLE is not set
# CONFIG_LV_USE_TABVIEW is not set
# CONFIG_LV_USE_TILEVIEW is not set
# CONFIG_LV_USE_WIN is not set
# CONFIG_LV_USE_THEME_SIMPLE is not set
# 禁用不需要的 draw 格式(ST7789 RGB565,不需要其他色深支持)。
# CONFIG_LV_DRAW_SW_SUPPORT_RGB888 is not set
# CONFIG_LV_DRAW_SW_SUPPORT_XRGB8888 is not set
# CONFIG_LV_DRAW_SW_SUPPORT_ARGB8888 is not set
# CONFIG_LV_DRAW_SW_SUPPORT_ARGB8888_PREMULTIPLIED is not set
# CONFIG_LV_DRAW_SW_SUPPORT_L8 is not set
# CONFIG_LV_DRAW_SW_SUPPORT_AL88 is not set
# CONFIG_LV_DRAW_SW_SUPPORT_A8 is not set

# --- 系统 ---
CONFIG_FREERTOS_HZ=1000

# --- Wi-Fi(ESP-NOW 依赖) ---
# ESP-NOW 需要 Wi-Fi 驱动初始化;不启用 BLE(协议栈占 ~150KB)。
# CONFIG_BT_ENABLED is not set
# CONFIG_BT_NIMBLE_ENABLED is not set
```
